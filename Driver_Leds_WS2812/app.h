
#pragma once
#include <FastLED.h>


/**
 * Classe abstraite regroupant les tableaux de constantes. Évite la réinstantiation pour chaque application du template.
 */
class Abstract {
private:
  static const uint8_t CIEL4[] PROGMEM;
  static const uint8_t CIEL2[] PROGMEM;
  static const uint8_t CIEL[] PROGMEM;
  static const uint8_t NORMALE[] PROGMEM;
};

/**
 * Courbes de compensation de la sensisibilité de l'oeil, sans scramble, avec 2 bits et avec 4 bits. 
 */
const uint8_t Abstract::CIEL4[] PROGMEM = { 0,0,0,0,1,1,1,0,1,1,1,1,2,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250,247 };
const uint8_t Abstract::CIEL2[] PROGMEM = { 0,0,0,0,1,0,1,1,1,1,1,1,1,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255,252 };
const uint8_t Abstract::CIEL[] PROGMEM = { 0,0,0,0,0,1,1,1,1,1,1,1,1,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252,255 };

/**
 * 1/2 fonction normale.
 */
const uint8_t Abstract::NORMALE[] PROGMEM = { 255,255,255,255,255,254,254,254,253,253,253,252,252,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1,1 };


template <byte NB_LED>
class Application : Abstract {
public:
/**
 * Lancée une fois à l'initialisation.
 */
  bool setup() {
    FastLED.addLeds<WS2812Controller800Khz, 8>(leds, NB_LED);
    return true;
  }

/**
 * Lancée itérativement.
 */
  bool loop() {
    normale();
    return true;
  }
  
/**
 * 
 */
  void printCIEL() {
    for (auto lum = 0; lum < 256; ++lum) {
      auto yMin = 0.0;
      auto yMax = 1.0;
      while (true) {
        const auto y = (yMin + yMax) / 2.0;
        if ((yMax - yMin) < 0.00001) {
          Serial.print(round(y*255));
          Serial.print(',');
          break;
        }
        const auto r = 255 * ciel(y) / 100;
        if (r < (lum^0x00)) yMin = y; else yMax = y;
      }
    }
    Serial.println();  
  }
  
/**
 * 
 */
void printNormale() {
  const auto ro = 0.283;
  const auto m = fNormale(0, 0, ro);
  for (auto x = 0; x < 256; ++x) {
    Serial.print(",");
    Serial.print(round(255 * fNormale(x / 256.0, 0, ro) / m));
  }
  Serial.println();
}

protected:
/**
 * Courbe log de l'éclairement (CIE Lightness lookup table function)
 * 5 bit CIE Lightness to 8 bit PWM conversion :
 *    L* = 116(Y/Yn)^1/3 - 16 , Y/Yn > 0.008856
 *    L* = 903.3(Y/Yn), Y/Yn <= 0.008856
 */
  float ciel(const float& y) {
    return y <= 0.008856 ? 903.3*y : 116*pow(y, 1/3.0) - 16;
  }
  
/**
 *
 */
  float fNormale(const float& x, const float& mu = 0, const float& ro = 1) {
    return exp(-0.5*pow((x-mu)/ro, 2)) / (ro*sqrt(2*PI));
  }

/**
 * Luminosité en triangle sur toute la barette (homogène).
 */
void triangle(const byte wait = 5) {
  for (auto t = 0; true; ++t) {
    for (auto i = 0; i < NB_LED; ++i) {
      const byte v = (t % 512) < 256 ? t % 256 : 255 - t % 256;
      leds[i].setRGB(pgm_read_byte_near(CIEL2 + v), 0, 0);
    }
    FastLED.show();
    delay(wait);
  }
}

/**
 * Courbe de sinus glissant.
 */
  void sinus(const byte wait = 5) {
    for (auto t = 0; true; ++t) {
      for (auto i = 0; i < NB_LED; ++i) {
        static const auto MAX = 50;
        const byte v = round(sin(2*PI*t/256+i) * MAX/2.0 + MAX/2.0);
          leds[i].setRGB(pgm_read_byte_near(CIEL2 + v), 0, 0);
      }
      FastLED.show();
      delay(wait);
    }
  }

  void normale(const byte wait = 1) {
    for (auto c = 0; c < 256; c += 10) {
      for (auto t = -500; t < 256; t += 1) {
        for (auto i = 0; i < NB_LED; ++i) {
          const auto j = t + 40 * i;
          const byte v = j < -255 ? 0 : (j <= 0 ? pgm_read_byte_near(NORMALE - j) : ( j <= 255 ? pgm_read_byte_near(NORMALE + j) : 0) );
          leds[i] = CHSV(c, 255, pgm_read_byte_near(CIEL + v));
        }
        FastLED.show();
        delay(wait);
      }
    }
  }
  
private:
  CRGB leds[NB_LED];

};
